## modules/net/quic/Kconfig
```kconfig
# SPDX-License-Identifier: GPL-2.0-or-later
#
# QUIC configuration
#

menuconfig IP_QUIC
	tristate "QUIC: A UDP-Based Multiplexed and Secure Transport (Experimental)"
	depends on INET
	depends on IPV6
	select NET_UDP_TUNNEL
	help
	  QUIC: A UDP-Based Multiplexed and Secure Transport

	  From rfc9000 <https://www.rfc-editor.org/rfc/rfc9000.html>.

	  QUIC provides applications with flow-controlled streams for structured
	  communication, low-latency connection establishment, and network path
	  migration.  QUIC includes security measures that ensure
	  confidentiality, integrity, and availability in a range of deployment
	  circumstances.  Accompanying documents describe the integration of
	  TLS for key negotiation, loss detection, and an exemplary congestion
	  control algorithm.

	  To compile this protocol support as a module, choose M here: the
	  module will be called quic. Debug messages are handled by the
	  kernel's dynamic debugging framework.

	  If in doubt, say N.

if IP_QUIC
config IP_QUIC_TEST
	depends on NET_HANDSHAKE || KUNIT
	def_tristate m
endif
```
